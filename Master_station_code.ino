#include <SPI.h>
#include <MFRC522.h>
#include <Arduino.h>
#include <Talkie.h>
//#include "Vocab_US_TI99.h"
#include <Wire.h> 
#include <LiquidCrystal_I2C.h>

// Set the LCD address to 0x3F for a 16 chars and 2 line display
LiquidCrystal_I2C lcd(0x3F, 16, 2);
#define SS_PIN 10
#define RST_PIN 9
MFRC522 mfrc522(SS_PIN, RST_PIN);   // Create MFRC522 instance.

//defining pin of led connection
#define led = 8

// defining tags 
#define BUS_01 = "F9 4A CC 98"
#define BP1 = "D0 49 DF A4"

Talkie voice;
//defining announcement words
const int8_t spB[] PROGMEM ={0xAB,0xED,0xD1,0x14,0x5D,0xBB,0xAD,0xB6,0x45,0x57,0xF0,0xDE,0x3A,0x9A,0x59,0x94,0x31,0x62,0xCD,0x6E,0x76,0xB3,0x9B,0xD9,0xF4,0xB6,0xB6,0xB1,0xB7,0x3D,0xEF,0x1F,0x00,0x00};
const int8_t spONE[] PROGMEM ={0x00,0x00,0x00,0x00,0x00,0x00,0x00,0x00,0x00,0x00,0x80,0x7e,0xf0,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0x00,0x00};
const int8_t spAT[] PROGMEM ={0x2B,0x8B,0xC9,0x3A,0x3D,0xA7,0xDC,0xE2,0x16,0xB7,0xD8,0x55,0x6F,0x62,0x03,0x00,0x0A,0xC8,0xCA,0xC5,0x00,0x4B,0xB8,0x11,0xC0,0xA9,0x60,0x80,0x07};
const int8_t spSTOP[] PROGMEM ={0x0E,0xD8,0x5A,0x3D,0x02,0x11,0xF0,0x00,0x40,0x00,0xBA,0x0F,0x5F,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0x00,0x00};
const int8_t spNUMBER[] PROGMEM ={0xA9,0x0D,0x0E,0x2A,0xDD,0x12,0xA7,0xD6,0x5B,0xE8,0x70,0x8F,0xBB,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0xED,0x3E};
const int8_t spTEN[] PROGMEM ={0x0A,0xB0,0xDC,0xD4,0x01,0x83,0x86,0x28,0x20,0x85,0x10,0x01,0xB8,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0x00,0x00};

int state = 0;
int flag = 0;

void station_announcement();
void looping_text();

void setup() 
{
  pinMode(3, OUTPUT);
  Serial.begin(9600);   // Initiate a serial communication
  SPI.begin();      // Initiate  SPI bus
  mfrc522.PCD_Init();   // Initiate MFRC522
  Serial.println("Approximate your card to the reader...");
  Serial.println();
  // initialize the led
  // initialize the LCD
  lcd.begin();
  // Turn on the blacklight and print a message.
  lcd.backlight();
  // LED setup
  pinMode(8, OUTPUT);
  digitalWrite(8, LOW);
// for the speaker
  voice.doNotUseInvertedOutput(true); //don’t use port 11
  voice.doNotUseNonInvertedOutput(false); // use only port 3
}

void loop() 
{

  Serial.write('0');
  // Look for new cards
  if ( ! mfrc522.PICC_IsNewCardPresent()) 
  {
    return;
  }
  // Select one of the cards
  if ( ! mfrc522.PICC_ReadCardSerial()) 
  {
    return;
  }
  //Show UID on serial monitor
  Serial.print("UID tag :");
  String content= "";
  byte letter;
  Serial.println();
  for (byte i = 0; i < mfrc522.uid.size; i++) 
  {
     Serial.print(mfrc522.uid.uidByte[i] < 0x10 ? " 0" : " ");
     Serial.print(mfrc522.uid.uidByte[i], HEX);
     content.concat(String(mfrc522.uid.uidByte[i] < 0x10 ? " 0" : " "));
     content.concat(String(mfrc522.uid.uidByte[i], HEX));
  }
  Serial.println();
  Serial.print("Message : ");
  content.toUpperCase();

    if (content.substring(1) == "D0 49 DF A4") //change here the UID of the card/cards that you want to give access
  {
    flag = 1;
    Serial.println("Person with needs, give way");
    Serial.println();
    digitalWrite(8, HIGH);
  }

  if (content.substring(1) == "F9 4A CC 98") //can write BUS 1 instead of this string (as defined above)
  {
    
    delay(2000);
    if (flag > 0)
    {Serial.write('2');}
    Serial.write('1');
    Serial.println("Authorized access: BUS 1");
    Serial.println();
    lcd.print("BUS ARRIVED: B1 ");
    station_announcement();                                                                                                    
    looping_text();
    Serial.write('3');
    delay(500);
    digitalWrite(8, LOW);
    flag = 0;
    lcd.clear();
  }

} 

void station_announcement()
{
    delay(1000);
    voice.sayQ(spB);
    voice.sayQ(spONE);
    delay(1000);
    voice.sayQ(spAT);
    delay(1000);
    voice.sayQ(spSTOP);
    voice.sayQ(spNUMBER);
    voice.sayQ(spTEN);
   }

void looping_text() {
  // scroll 13 positions (string length) to the left
  // to move it offscreen left:
  for (int positionCounter = 0; positionCounter < 13; positionCounter++) {
    // scroll one position left:
    lcd.scrollDisplayLeft();
    // wait a bit:
    delay(250);
  }
  lcd.clear();
  lcd.print("BUS ARRIVED: B1 ");
  station_announcement();   

  // scroll 29 positions (string length + display length) to the right
  // to move it offscreen right:
  for (int positionCounter = 0; positionCounter < 29; positionCounter++) {
    // scroll one position right:
    lcd.scrollDisplayRight();
    // wait a bit
    delay(250);
  }
  
  lcd.clear();
  lcd.print("BUS ARRIVED: B1 ");
  station_announcement();   
}
