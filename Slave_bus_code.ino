#include <Arduino.h>
#include <Talkie.h>
//#include "Vocab_US_TI99.h"
#include <Wire.h> 
#include <LiquidCrystal_I2C.h>

// Set the LCD address to 0x3F for a 16 chars and 2 line display
LiquidCrystal_I2C lcd(0x3F, 16, 2);
int state = 0;

Talkie voice;
const int8_t spSTOP[] PROGMEM ={0x0E,0xD8,0x5A,0x3D,0x02,0x11,0xF0,0x00,0x40,0x00,0xBA,0x0F,0x5F,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0x00,0x00};
const int8_t spNUMBER[] PROGMEM ={0xA9,0x0D,0x0E,0x2A,0xDD,0x12,0xA7,0xD6,0x5B,0xE8,0x70,0x8F,0xBB,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0xED,0x3E};
const int8_t spTEN[] PROGMEM ={0x0A,0xB0,0xDC,0xD4,0x01,0x83,0x86,0x28,0x20,0x85,0x10,0x01,0xB8,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0x00,0x00};



void looping_text();
void bus_announcement();

void setup() {
  // put your setup code here, to run once:
  Serial.begin(9600);   // Initiate a serial communication
// initialize the LCD
  lcd.begin();
  // Turn on the blacklight and print a message.
  lcd.backlight();
  pinMode(8, OUTPUT);
  digitalWrite(8, LOW);
// for the speaker
  voice.doNotUseInvertedOutput(true); //don’t use port 11
  voice.doNotUseNonInvertedOutput(false); // use only port 3
}

void loop() {
  // put your main code here, to run repeatedly

  if (Serial.available()>0)
  {
    state = Serial.read();
  }
   if (state == '2')
  {
  // make the led blink when blink person has been recognized (until blind person moves away from the stop)
    digitalWrite(8, HIGH);
  }

  if (state == '1')
  {
    // speaker say arrived at station 
    // lcd screen say name of station
    lcd.setCursor(0,0);
   lcd.print("B1 AT ");
   lcd.setCursor(0,1);
   lcd.print("STOP 10 ");
    bus_announcement();
     looping_text();
    // lcd screen clear
   lcd.clear();
  }

  if (state == '3')
  {
  // make the led blink when blink person has been recognized (until blind person moves away from the stop)
    digitalWrite(8, LOW);
  }
  
}
void bus_announcement()
{
    delay(1000);
  voice.sayQ(spSTOP);
  voice.sayQ(spNUMBER);
  voice.sayQ(spTEN);
}


void looping_text() {
  // scroll 13 positions (string length) to the left
  // to move it offscreen left:
  for (int positionCounter = 0; positionCounter < 13; positionCounter++) {
    // scroll one position left:
    lcd.scrollDisplayLeft();
    // wait a bit:
    delay(250);
  }

  lcd.clear();
   lcd.setCursor(0,0);
   lcd.print("B1 AT ");
   lcd.setCursor(0,1);
   lcd.print("STOP 10 ");
    bus_announcement();
    
  // scroll 29 positions (string length + display length) to the right
  // to move it offscreen right:
  for (int positionCounter = 0; positionCounter < 29; positionCounter++) {
    // scroll one position right:
    lcd.scrollDisplayRight();
    // wait a bit:
    delay(250);
  }
  lcd.clear();
   lcd.setCursor(0,0);
   lcd.print("B1 AT ");
   lcd.setCursor(0,1);
   lcd.print("STOP 10 ");
    bus_announcement();
    
  lcd.clear();
}
